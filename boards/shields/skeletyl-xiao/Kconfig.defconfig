## boards/shields/skeletyl-xiao/Kconfig.defconfig
```kconfig
# Copyright (c) 2022 The ZMK Contributors
# SPDX-License-Identifier: MIT

if SHIELD_SKELETYL_XIAO_LEFT

config ZMK_KEYBOARD_NAME
    default "SKELETYL"

config ZMK_SPLIT_ROLE_CENTRAL
    default y

endif

if SHIELD_SKELETYL_XIAO_LEFT || SHIELD_SKELETYL_XIAO_RIGHT

config ZMK_SPLIT
    default y

endif
```

## boards/shields/skeletyl-xiao/Kconfig.shield
```kconfig
# Copyright (c) 2022 The ZMK Contributors
# SPDX-License-Identifier: MIT

config SHIELD_SKELETYL_XIAO_LEFT
    def_bool $(shields_list_contains,skeletyl_xiao_left)

config SHIELD_SKELETYL_XIAO_RIGHT
    def_bool $(shields_list_contains,skeletyl_xiao_right)
```
